/**
 * @cliArgs --device "MSPM0G350X" --part "Default" --package "LQFP-64(PM)" --product "mspm0_sdk@2.10.00.04"
 * @versions {"tool":"1.26.2+4477"}
 */

/**
 * Import the modules used in this configuration.
 */
const GPIO      = scripting.addModule("/ti/driverlib/GPIO", {}, false);
const GPIO_KEYS = GPIO.addInstance();
const GPIO_LEDS = GPIO.addInstance();
const RUN_LED   = GPIO.addInstance();
const SYSCTL    = scripting.addModule("/ti/driverlib/SYSCTL");

/**
 * Write custom configuration values to the imported modules.
 */
const divider5       = system.clockTree["PLL_CLK1_DIV"];
divider5.divideValue = 4;

const divider6       = system.clockTree["PLL_CLK2X_DIV"];
divider6.divideValue = 4;

const divider7       = system.clockTree["PLL_PDIV"];
divider7.divideValue = 2;

const divider9       = system.clockTree["UDIV"];
divider9.divideValue = 2;

const multiplier2         = system.clockTree["PLL_QDIV"];
multiplier2.multiplyValue = 10;

const mux8       = system.clockTree["HSCLKMUX"];
mux8.inputSelect = "HSCLKMUX_SYSPLL2X";

GPIO_KEYS.$name                              = "GPIO_KEYS";
GPIO_KEYS.associatedPins.create(3);
GPIO_KEYS.associatedPins[0].$name            = "PA12";
GPIO_KEYS.associatedPins[0].direction        = "INPUT";
GPIO_KEYS.associatedPins[0].internalResistor = "PULL_UP";
GPIO_KEYS.associatedPins[0].assignedPort     = "PORTA";
GPIO_KEYS.associatedPins[0].assignedPin      = "12";
GPIO_KEYS.associatedPins[1].$name            = "PB23";
GPIO_KEYS.associatedPins[1].direction        = "INPUT";
GPIO_KEYS.associatedPins[1].internalResistor = "PULL_UP";
GPIO_KEYS.associatedPins[1].assignedPort     = "PORTB";
GPIO_KEYS.associatedPins[1].assignedPin      = "23";
GPIO_KEYS.associatedPins[2].$name            = "PB27";
GPIO_KEYS.associatedPins[2].direction        = "INPUT";
GPIO_KEYS.associatedPins[2].internalResistor = "PULL_UP";
GPIO_KEYS.associatedPins[2].assignedPort     = "PORTB";
GPIO_KEYS.associatedPins[2].assignedPin      = "27";

GPIO_LEDS.$name                         = "GPIO_LEDS";
GPIO_LEDS.associatedPins.create(3);
GPIO_LEDS.associatedPins[0].$name        = "LED1";
GPIO_LEDS.associatedPins[0].assignedPort = "PORTB";
GPIO_LEDS.associatedPins[0].assignedPin  = "15";
GPIO_LEDS.associatedPins[1].$name        = "LED2";
GPIO_LEDS.associatedPins[1].assignedPort = "PORTB";
GPIO_LEDS.associatedPins[1].assignedPin  = "16";
GPIO_LEDS.associatedPins[2].$name        = "LED3";
GPIO_LEDS.associatedPins[2].assignedPort = "PORTB";
GPIO_LEDS.associatedPins[2].assignedPin  = "13";

RUN_LED.$name                         = "RUN_LED";
RUN_LED.associatedPins[0].$name       = "LED0";
RUN_LED.associatedPins[0].assignedPort = "PORTB";
RUN_LED.associatedPins[0].assignedPin  = "22";

const Board = scripting.addModule("/ti/driverlib/Board", {}, false);

SYSCTL.MCLKSource            = "HSCLK";
SYSCTL.SYSPLL_CLK2XEn        = true;
SYSCTL.SYSPLL_CLK2XDiv       = 1;
SYSCTL.HSCLKSource           = "SYSPLLCLK2X";
SYSCTL.validateClkStatus     = true;
SYSCTL.SYSPLL_Qdiv           = 5;
SYSCTL.forceDefaultClkConfig = true;
SYSCTL.clockTreeEn           = true;
